## conf/layer.conf
```bitbake
# We have a conf and classes directory, add to BBPATH
BBPATH .= ":${LAYERDIR}"

# We have recipes-* directories, add to BBFILES
BBFILES += "${LAYERDIR}/recipes-*/*/*.bb \
	${LAYERDIR}/recipes-*/*/*.bbappend"

BBFILE_COLLECTIONS += "labgrid"
BBFILE_PATTERN_labgrid = "^${LAYERDIR}/"
BBFILE_PRIORITY_labgrid = "8"

LAYERDEPENDS_labgrid = "core"
LAYERDEPENDS_labgrid += "meta-python"

LAYERSERIES_COMPAT_labgrid = "sumo rocko thud warrior zeus dunfell"
```
